## testing/ztest/Kconfig
```kconfig
config GABS_TESTING
    bool "gabs test framework (ztest)"
    select ZTEST
    select CPP
    select REQUIRES_FULL_LIBCPP
    help
      Build the gabs tests with ztest. The C++ standard is a choice, which
      cannot be selected here; the application sets CONFIG_STD_CPP17.

if GABS_TESTING

config GABS_TESTING_ASYNC_STACK_SIZE
    int "Stack size of the gabs::testing::async() work queue"
    default 4096

config GABS_TESTING_ASYNC_PRIORITY
    int "Priority of the gabs::testing::async() work queue"
    default 0
    help
      With the default CONFIG_ZTEST_THREAD_PRIORITY, each case runs in a
      cooperative thread, so a task only runs while the case waits. The
      default is the highest preemptible priority.

endif # GABS_TESTING
```

## tests/alloc/zephyr/testcase.yaml
```yaml
tests:
  libraries.gabs.alloc:
    tags:
      - gabs
    integration_platforms:
      - native_sim
```

## tests/cmake/zephyr/testcase.yaml
```yaml
tests:
  libraries.gabs.cmake:
    tags:
      - gabs
    integration_platforms:
      - native_sim
```

## tests/log/zephyr/testcase.yaml
```yaml
tests:
  libraries.gabs.log:
    tags:
      - gabs
    integration_platforms:
      - native_sim
```

## tests/mutex/zephyr/testcase.yaml
```yaml
tests:
  libraries.gabs.mutex:
    tags:
      - gabs
    integration_platforms:
      - native_sim
```

## tests/pbuf/zephyr/testcase.yaml
```yaml
tests:
  libraries.gabs.pbuf:
    tags:
      - gabs
    integration_platforms:
      - native_sim
```

## tests/semaphore/zephyr/testcase.yaml
```yaml
tests:
  libraries.gabs.semaphore:
    tags:
      - gabs
    integration_platforms:
      - native_sim
```

## tests/testing/zephyr/testcase.yaml
```yaml
common:
  tags:
    - gabs
  integration_platforms:
    - native_sim
tests:
  libraries.gabs.testing: {}
  libraries.gabs.testing.all:
    build_only: true
    extra_configs:
      - CONFIG_GABS_ALLOC=y
      - CONFIG_GABS_ALLOC_STD=y
      - CONFIG_GABS_ALLOC_ZEPHYR_HEAP=y
      - CONFIG_GABS_ALLOC_ZEPHYR_NETBUF=y
      - CONFIG_GABS_LOG=y
      - CONFIG_GABS_MUTEX=y
      - CONFIG_GABS_PBUF=y
      - CONFIG_GABS_RANDOM=y
      - CONFIG_GABS_SEMAPHORE=y
      - CONFIG_GABS_TIMER=y
      - CONFIG_NET_BUF=y
```

## tests/timer/manual/zephyr/testcase.yaml
```yaml
tests:
  libraries.gabs.timer.manual:
    tags:
      - gabs
    integration_platforms:
      - native_sim
```

## tests/timer/zephyr/testcase.yaml
```yaml
tests:
  libraries.gabs.timer:
    tags:
      - gabs
    integration_platforms:
      - native_sim
```

## tests/zephyr/testcase.yaml
```yaml
tests:
  libraries.gabs.api:
    tags:
      - gabs
    integration_platforms:
      - native_sim
```

## zephyr/Kconfig
```kconfig
menuconfig GABS
    bool "Enable GABS"
    default y

if GABS

config GABS_ALLOC
    bool "Allocators"

if GABS_ALLOC

config GABS_ALLOC_STD
    bool "Allocator using malloc() and free()"

config GABS_ALLOC_ZEPHYR_HEAP
    bool "Allocator using a Zephyr heap"

config GABS_ALLOC_ZEPHYR_NETBUF
    bool "Allocator using a net_buf pool"
    depends on NET_BUF

endif # GABS_ALLOC

config GABS_LOG
    bool "Logging"

config GABS_MUTEX
    bool "Mutexes"

config GABS_PBUF
    bool "Packet buffers"
    depends on NET_BUF
    select GABS_ALLOC

config GABS_RANDOM
    bool "Random numbers"

config GABS_SEMAPHORE
    bool "Semaphores"

config GABS_TIMER
    bool "Timers"

if GABS_TIMER

choice GABS_TIMER_IMPL
    prompt "Timer implementation"
    default GABS_TIMER_ZEPHYR

config GABS_TIMER_ZEPHYR
    bool "Zephyr timers"

config GABS_TIMER_MANUAL
    bool "Timers fired by the application"
    help
      Timers only expire when the application calls
      gabs_timer_manual_advance() or gabs_timer_manual_fire(). This is meant
      for tests.

endchoice

endif # GABS_TIMER

rsource "../testing/ztest/Kconfig"

endif # GABS

module = GABS
module-str = gabs
source "subsys/logging/Kconfig.template.log_config"
```
